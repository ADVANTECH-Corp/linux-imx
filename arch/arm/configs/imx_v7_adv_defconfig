## drivers/net/wireless/mrvl8897/Kconfig
```kconfig
config MWIFIEX_PCIE_8897
	tristate "Marvell WiFi-Ex Driver for PCIE 8897"
	depends on CFG80211 && PCI
	select FW_LOADER
	---help---
	This adds support for wireless adapters based on Marvell
	8897 chipsets with PCIe interface.

	If you choose to build it as a module, it will be called
	mlan.ko and pcie8xxx.ko.


config MWIFIEX_USB_8897
	tristate "Marvell WiFi-Ex Driver for USB 8897"
	depends on CFG80211 && USB
	select FW_LOADER
	---help---
	This adds support for wireless adapters based on Marvell
	8897 chipset with USB interface.

	If you choose to build it as a module, it will be called
	bt8xxx.ko.
```

## drivers/net/wireless/nxp/mxm5x17283/Kconfig
```kconfig
# SPDX-License-Identifier: GPL-2.0-only
#
# NXP Wireless device configuration
#
config MXM5X17283
	tristate "NXP MxM 5x17283 WiFi Driver"
	depends on CFG80211
	help
		This driver is multi-chip-multi-interface driver
		(indicating Multi-Chip x Multi-Interface support) based on
		NXP 802.11n/ac chipsets. If you choose to build it as a module,
		it will be build 2 modules moal.ko and mlan.ko.
```

## drivers/net/wireless/nxp/mxm6x17408/Kconfig
```kconfig
# SPDX-License-Identifier: GPL-2.0-only
#
# NXP Wireless device configuration
#
config MXM6X17408
	tristate "NXP MxM MXM6X17408 WiFi Driver"
	depends on CFG80211
	help
		This driver is multi-chip-multi-interface driver
		(indicating Multi-Chip x Multi-Interface support) based on
		NXP 802.11n/ac chipsets. If you choose to build it as a module,
		it will be build 2 modules moal.ko and mlan.ko.
```

## drivers/net/wireless/rtlwifi/rtl8188ee_advantech/Kconfig
```kconfig
config RTL8188EE
	tristate "Realtek 8188E PCI WiFi"
	depends on PCI
	---help---
	  Help message of RTL8188EE
```
