&lpi2c8 {
	clock-frequency = <400000>;
	pinctrl-names = "default";
	pinctrl-0 = <&pinctrl_lpi2c8>;
	status = "okay";
};

&scmi_iomuxc {
	pinctrl_lpi2c8: lpi2c8grp {
		fsl,pins = <
			IMX95_PAD_GPIO_IO10__LPI2C8_SDA		0x40000b9e
			IMX95_PAD_GPIO_IO11__LPI2C8_SCL		0x40000b9e
		>;
	};
};
