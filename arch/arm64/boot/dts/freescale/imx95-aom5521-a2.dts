// SPDX-License-Identifier: (GPL-2.0+ OR MIT)
/*
 * Copyright 2025 Advantech
 */

#include "imx95-19x19-evk.dts"

/ {
	model = "Advantech AOM-5521 A2 board";
};

/*
 * Step1. Include the difference set dtsi to remove some contents from EVK.
 */
#include "imx95-aom5521-a2-difference.dtsi"

/*
 * Step2. The features of the device tree are added below
 */
#include "imx95-aom5521-a2-usb2.dtsi"
#include "imx95-aom5521-a2-gpioexp.dtsi"
#include "imx95-aom5521-a2-gpio.dtsi"
#include "imx95-aom5521-a2-usbotg.dtsi"
