// SPDX-License-Identifier: (GPL-2.0+ OR MIT)
/*
 * Copyright 2025 Advantech
 */

#include "imx95-19x19-evk.dts"

/ {
	model = "Advantech AOM-2521 B0 board";
};

/*
 * Step1. Include the difference set dtsi to remove some contents from EVK.
 */
#include "imx95-aom2521-b0-difference.dtsi"

/*
 * Step2. The features of the device tree are added below
 */
#include "imx95-aom2521-b0-usb2.dtsi"
#include "imx95-aom2521-b0-gpioexp.dtsi"
#include "imx95-aom2521-b0-gpio.dtsi"
#include "imx95-aom2521-b0-usbotg.dtsi"
//#include "imx95-aom2521-b0-typc-otg.dtsi" /*To use TYPC, you need to enable imx95-aom2521-b0-typc-otg.dtsi and disable imx95-aom2521-b0-usbotg.dtsi.*/
#include "imx95-aom2521-b0-lpi2c2.dtsi"
#include "imx95-aom2521-b0-lpi2c3.dtsi"
#include "imx95-aom2521-b0-lpi2c7.dtsi"
#include "imx95-aom2521-b0-lpi2c8.dtsi"
#include "imx95-aom2521-b0-lpuart5.dtsi"
#include "imx95-aom2521-b0-lpuart6.dtsi"
#include "imx95-aom2521-b0-enet.dtsi"
#include "imx95-aom2521-b0-enet-tg.dtsi"
#include "imx95-aom2521-b0-lt9611uxc.dtsi"
#include "imx95-aom2521-b0-lpspi4.dtsi"
#include "imx95-aom2521-b0-lpspi4-nor-flash.dtsi"
#include "imx95-aom2521-b0-can.dtsi"
#include "imx95-aom2521-b0-pcie0.dtsi"
#include "imx95-aom2521-b0-rtc-rx8900.dtsi"
#include "imx95-aom2521-b0-pcie1-m2.dtsi"
#include "imx95-aom2521-b0-sound-sgtl5000.dtsi"
#include "imx95-aom2521-b0-cam-ov5640.dtsi"
