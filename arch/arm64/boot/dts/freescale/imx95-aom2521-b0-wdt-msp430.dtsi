&lpi2c2 {
	wdt: msp430g2202@29 {
		compatible = "fsl,adv-wdt-i2c";
		reg = <0x29>;
		pinctrl-names = "default";
		pinctrl-0 = <&pinctrl_wdt>;
		wdt-en-gpio = <&gpio3 27 GPIO_ACTIVE_HIGH>;
		wdt-ping-gpio = <&gpio4 15 GPIO_ACTIVE_HIGH>;
		status = "okay";
	};
};

&scmi_iomuxc {
	pinctrl_wdt: wdt_grp {
		fsl,pins = <
			IMX95_PAD_CCM_CLKO2__GPIO3_IO_BIT27		0x31e	/* WDT_EN */
			IMX95_PAD_ENET2_MDIO__GPIO4_IO_BIT15		0x31e	/* WDT_TRIG */
		>;
	};
};
