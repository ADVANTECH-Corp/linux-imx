&scmi_iomuxc {
	pinctrl-names = "default";
	pinctrl-0 = <&pinctrl_hog>;

	pinctrl_hog: hoggrp {
		fsl,pins = <
			IMX95_PAD_XSPI1_SCLK__GPIO5_IO_BIT9             0x51e /* GPIO_A_2 */
			IMX95_PAD_XSPI1_DATA0__GPIO5_IO_BIT0		0x51e /* GPIO_A_3 */
			IMX95_PAD_XSPI1_DATA1__GPIO5_IO_BIT1            0x51e /* GPIO_A_4 */
			IMX95_PAD_GPIO_IO22__GPIO2_IO_BIT22             0x51e /* GPIO_A_5 */
			IMX95_PAD_GPIO_IO23__GPIO2_IO_BIT23             0x51e /* GPIO_A_7 */
			IMX95_PAD_SD3_DATA1__GPIO3_IO_BIT23             0x51e /* USB_B_OC */
		>;
	};
};
