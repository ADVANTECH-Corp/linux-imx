&flexcan1 {
	status = "okay";
};

&flexcan3 {
	pinctrl-names = "default";
	pinctrl-0 = <&pinctrl_flexcan3>;
	status = "okay";
};

&scmi_iomuxc {
	pinctrl_flexcan3: flexcan3grp {
		fsl,pins = <
			IMX95_PAD_CCM_CLKO3__CAN3_TX		0x39e
			IMX95_PAD_CCM_CLKO4__CAN3_RX		0x39e
		>;
	};
};
