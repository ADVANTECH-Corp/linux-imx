#ifndef __DTSI_AOM5521_LPUART5__
#define __DTSI_AOM5521_LPUART5__

&lpuart5 {
	pinctrl-names = "default";
	pinctrl-0 = <&pinctrl_uart5>;
	fsl,uart-has-rtscts;
	linux,rs485-enabled-at-boot-time;
	rs485-rx-during-tx;
	status = "okay";
};

&scmi_iomuxc {
	pinctrl_uart5: uart5grp {
		fsl,pins = <
			IMX95_PAD_GPIO_IO00__LPUART5_TX		0x31e
			IMX95_PAD_GPIO_IO01__LPUART5_RX		0x31e
			IMX95_PAD_GPIO_IO02__LPUART5_CTS_B	0x31e
			IMX95_PAD_GPIO_IO03__LPUART5_RTS_B	0x31e
		>;
	};
};

#endif
