/*
 * Copyright 2018 NXP
 *
 * This program is free software; you can redistribute it and/or
 * modify it under the terms of the GNU General Public License
 * as published by the Free Software Foundation; either version 2
 * of the License, or (at your option) any later version.
 *
 * This program is distributed in the hope that it will be useful,
 * but WITHOUT ANY WARRANTY; without even the implied warranty of
 * MERCHANTABILITY or FITNESS FOR A PARTICULAR PURPOSE.  See the
 * GNU General Public License for more details.
 */

#include "imx8mm-rom5721-a1.dts"

/ {
};
&mipi_dsi {
        panel@0 {
                compatible = "auo,g150xgel05";
                reg = <0>;
                backlight=<&lvds_backlight0>;
		panel-init-sequence = [
                                29 00 06 3C 01 05 00 03 00
                                29 00 06 14 01 03 00 00 00
                                29 00 06 64 01 04 00 00 00
                                29 00 06 68 01 04 00 00 00
                                29 00 06 6C 01 04 00 00 00
                                29 00 06 70 01 04 00 00 00
                                29 00 06 34 01 1F 00 00 00
                                29 00 06 10 02 1F 00 00 00
                                29 00 06 04 01 01 00 00 00
                                29 00 06 04 02 01 00 00 00
                                29 00 06 50 04 20 01 F0 03
                                29 00 06 54 04 0A 00 0A 00
                                29 00 06 58 04 00 04 2C 01
                                29 00 06 5C 04 04 00 04 00
                                29 00 06 60 04 00 03 1E 00
                                29 00 06 64 04 01 00 00 00
                                29 01 06 A0 04 06 80 44 00
                                29 00 06 A0 04 06 80 04 00
                                29 00 06 04 05 04 00 00 00
                                29 00 06 80 04 00 01 02 03
                                29 00 06 84 04 04 07 05 08
                                29 00 06 88 04 09 0A 0E 0F
                                29 00 06 8C 04 0B 0C 0D 10
                                29 00 06 90 04 16 17 11 12
                                29 00 06 94 04 13 14 15 1B
                                29 14 06 98 04 18 19 1A 06
                                29 78 06 9C 04 31 00 00 00
		];
	};
};
