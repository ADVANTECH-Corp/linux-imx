&lpi2c3 {
	clock-frequency = <400000>;
	pinctrl-names = "default";
	pinctrl-0 = <&pinctrl_lpi2c3>;
	status = "okay";
};

&scmi_iomuxc {
	pinctrl_lpi2c3: lpi2c3grp {
		fsl,pins = <
			IMX95_PAD_GPIO_IO28__LPI2C3_SDA		0x40000b9e
			IMX95_PAD_GPIO_IO29__LPI2C3_SCL		0x40000b9e
		>;
	};
};
